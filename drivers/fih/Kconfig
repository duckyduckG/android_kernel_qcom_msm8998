## drivers/fih/Kconfig
```kconfig
#
# fih driver
#

menu "fih driver"

config FIH_GPIO
	bool "fih gpio"
	default n
	help
	  support fih gpio function

config FIH_INFO
	bool "fih info"
	default y
	help
	  support fih info virtual file

config FIH_MFD
	bool "fih mfd"
	default y
	help
	  support fih mfd virtual file

config FIH_NV
	bool "fih nv"
	default y
	help
	  support fih nv virtual file

config FIH_APR
	bool "fih apr"
	default y
	help
	  support fih apr virtual file

config FIH_UFSINFO
	bool "fih ufs info"
	default n
	help
	  support fih ufs info virtual file

config FIH_DDR
	bool "fih ddr"
	default y
	help
	  support fih ddr virtual file

config FIH_SENSOR
	bool "fih sensor"
	default y
	help
	  support fih sensor virtual file

config FIH_SIBEAM_GPIO
	bool "fih SIBEAM"
	default n
	help
	  support fih SIBEAM virtual file

config FIH_MFR
	bool "fih mfr"
	default y
	help
	  support fih modem failure reason virtual file

config FIH_TOUCH
        bool "fih touch"
        default y
        help
          support fih touch virtual file

config FIH_LCM
	bool "fih lcm"
	default y
	help
	  support fih lcm function

config FIH_EMMC
	bool "fih emmc"
	default y
	help
	  support fih emmc function

config FIH_FVER
	bool "fih fver"
	default y
	help
	  support fih fver function

config FIH_USB
	bool "fih usb"
	default y
	help
	  support fih emmc function

config FIH_HWCONFIG
	bool "fih hwcfg/swid/hwid"
	default y
	help
	  support fih hwcfg/swid/hwid function

config FIH_DEVICE_TREE_DEBUG
	bool "FIH Device Tree Debug"
	default y

config FIH_HALL_SENSOR
	bool "FIH Hall sensor"
	default y

config FIH_CPU_USAGE
	bool "FIH cpu usage information"
	default n
	help
	  support fih cpu usage information

config FIH_DEBUG
	bool "fih debug"
	default n
	help
	  enable fih debugging

endmenu
```

## drivers/input/touchscreen/fih/Kconfig
```kconfig
# SW4-HL-TP-BringUpILI2121-00+_20170327
source "drivers/input/touchscreen/fih/ilitek_fih/Kconfig"
# SW4-HL-TP-BringUpGT915L-00+_20180119
source "drivers/input/touchscreen/fih/gt9xx_fih/Kconfig"
source "drivers/input/touchscreen/fih/focaltech_touch_fih/Kconfig"
source "drivers/input/touchscreen/fih/nt36xxx_fih/Kconfig"
source "drivers/input/touchscreen/fih/gt1x_fih/Kconfig"
source "drivers/input/touchscreen/fih/focaltech_touch_8719_fih/Kconfig"
```

## drivers/input/touchscreen/fih/gt1x_fih/Kconfig
```kconfig
#
# Goodix Touchscreen driver configuration
#

config TOUCHSCREEN_GX_FIH
        bool "Goodix Touchscreen"
		depends on I2C
		default n
		help
		  Say Y here if you have Goodix touch panel.
		  If unsure, say N.


config TOUCHSCREEN_GX_FIH_TESTS
        bool "Goodix Touchscreen"
		depends on TOUCHSCREEN_GX_FIH
		default n
		help
		  Say Y here if you want to enable tests.
		  If unsure, say N.

config TOUCHSCREEN_GX_DIRECTORY_FIH
    string "Goodix ts directory name"
    default "gt1x"
    depends on TOUCHSCREEN_GX_FIH
    
```

## drivers/input/touchscreen/focal_ft8719/Kconfig
```kconfig
#
# Focaltech Touchscreen driver configuration
#

config TOUCHSCREEN_FOCAL_FT8719
        bool "Focaltech Touchscreen"
		depends on I2C
		default n
		help
		  Say Y here if you have Focaltech touch panel.
		  If unsure, say N.

config TOUCHSCREEN_FTS_DIRECTORY_FT8719
    string "Focaltech ts directory name"
    default "focaltech_touch"
    depends on TOUCHSCREEN_FOCAL_FT8719
    
```

## drivers/power/supply/Kconfig
```kconfig
source "drivers/power/supply/qcom/Kconfig"
source "drivers/power/supply/fih/Kconfig"
```

## drivers/power/supply/fih/Kconfig
```kconfig
menu "Power drivers for FIH devices"

config CHARGER_BQ25600_SLAVE
	tristate "TI BQ25600 battery charger slave driver"
	depends on I2C
	help
	  Say Y to enable support for the TI BQ25600 battery charger.

config WIRELESS_CHARGER_STWLC33
	bool "ST STWLC33 Wireless Charging control Driver"
	depends on I2C
	help
	  ST STWLC33 wireless charging control driver

config WIRELESS_CHARGER_P9221
	bool "IDT P9221 Wireless Charging control Driver"
	depends on I2C
	help
	  IDT P9221 wireless charging control driver

endmenu
```
